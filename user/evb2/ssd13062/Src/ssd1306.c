#include "stdlib.h"
#include "printf_config.h"
#include "SSD1306OLED.h"
#include "as32m0_pwm.h"

void _sys_exit(void);

extern uint8_t ssd1306_buffer[SSD1306_LCDHEIGHT * SSD1306_LCDWIDTH / 8];
const uint8_t ASC_Bitmap [] = {
0x00, 0x00, 0x00, 0x00, 0x00, 0x00, 0x00, 0x00, 0x00, 0x00, 0x00, 0x00, 0x00, 0x00, 0x00, 0x00,
0x00, 0x00, 0x00, 0x00, 0x00, 0x00, 0x00, 0x00, 0x00, 0x00, 0x00, 0x00, 0x00, 0x00, 0x00, 0x00,
0x00, 0x00, 0x00, 0x00, 0x00, 0x00, 0x00, 0x00, 0x00, 0x00, 0x00, 0x00, 0x00, 0x00, 0x00, 0x00,
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0x00, 0x00, 0x00, 0x00, 0x00, 0x00, 0x00, 0x00, 0x00, 0x00, 0x00, 0x00, 0x00, 0x00, 0x00, 0x00
};



/**
	* @brief  initial APB_PWM3 (PWM6) for beepper (4KHz, 78:22)
  * @param  void 
  */
uint32_t init_beep(void) {
	
	PWM_INFO pwm_info;
	int32_t ret;
	

	pwm_info.int_en = 0;				// pwm interrupt 0=disable, 1=enable
	pwm_info.div = 2;
	pwm_info.lmt = 3000;


	pwm_info.ch_1_info.ch_n_point = 2000;			//@ SPWM ch1 only
	pwm_info.ch_1_info.ch_p_point = 0;
	pwm_info.ch_1_info.oc_en      = 1;
	pwm_info.ch_1_info.oen_n      = 1;
	pwm_info.ch_1_info.oen_p      = 1;
	pwm_info.ch_1_info.out_n      = 1;
	pwm_info.ch_1_info.out_p      = 0;

	//printf("Configing APB_PWM3 beep \n");
	ret = apPWM_Config(APB_PWM3, &pwm_info);				// APB_PWM3 is pin PWM6
	if(ret < 0){
		printf("[%d] Check CMD Status busy \n",__LINE__);
	}	
	// APB_PINC->PB6.FuncSel = 0xC0; // SWITCH TO GPIO
	APB_PINC->PB6.FuncSel = 0xF0; // SWITCH TO GPIO
	return ret;
}

int main()
{
	// prepare printf (uart0)
	config_uart0(OSC_CLK_FREQ, UART_SETBAUD, UART0_PD23);
	
	printf("==> \n");
	printf("==> \n");
	printf("==> TEST SSD1306 \n");
	printf("==> \n");
	printf("==> \n");
	// wait
	while(apUART_Check_BUSY(APB_UART0) == 1);
	
	init_beep();
	
	//-------  System Config ----------
	uint8_t str[] = "BB\0";
	
	SSD1306_I2C_init();
	SSD1306_OLED_init();
	SSD1306_Dim(FALSE);
	SSD1306_Display();
	delay_s(5);
	// SSD1306_ClearDisplay();
	SSD1306_DisplayRotate(1);
	delay_ms(1500);
	SSD1306_DisplayOnOFF(0);
	delay_ms(1500);
	SSD1306_StartScrollLeft(0, 7);
	// SSD1306_LeftHScrol(0, 0, 7);
	SSD1306_DisplayOnOFF(1);
	delay_ms(5000);
	SSD1306_StopScroll();
	//SSD1306_Display();
	SSD1306_Dim(TRUE);
	SSD1306_Dim(FALSE);
	delay_ms(1500);
	SSD1306_StartScrollRight(0,7);
	delay_ms(5000);
	SSD1306_StopScroll();
	delay_ms(500);
//	SSD1306_ClearDisplay();
  for (uint16_t i = 0; i < (SSD1306_LCDWIDTH*SSD1306_LCDHEIGHT / 8); i++) {
      for (uint8_t x = 0; x < 16; x++) {
        ssd1306_buffer[i] = ASC_Bitmap[i];
        i++;
      }
      i--;
    }
	delay_ms(5000);
	SSD1306_Display();
	SSD1306_TextSize(1);
	SSD1306_GotoXY(0,0);
	SSD1306_Print('A');
	SSD1306_Print('-');
	SSD1306_Print('C');
	SSD1306_Print('h');
	SSD1306_Print('i');
	SSD1306_Print('n');
	SSD1306_Print('a');
	SSD1306_Print(' ');
	SSD1306_Display();
	SSD1306_DrawLine(10, 10, 100, 20, TRUE);
	SSD1306_DrawFastHLine(0,20, 120, TRUE);
	SSD1306_DrawFastVLine(50,0,60,TRUE);
	SSD1306_DrawCircle(50,30,10);
	SSD1306_FillCircle(80, 25, 20, TRUE);
	SSD1306_DrawRect(0,55, 80, 8);
	SSD1306_FillRect(8,40, 60, 8, TRUE);
	SSD1306_DrawChar(90,50,'Z',2);
	SSD1306_DrawText(100,50,str,1);
	SSD1306_Display();
	
	while(1){
		
		SSD1306_StopScroll();
		delay_ms(1000);
		SSD1306_Dim(TRUE);
		SSD1306_InvertDisplay(TRUE);
		SSD1306_StartScrollLeft(0, 7);
		delay_ms(7000);
		SSD1306_StopScroll();
		delay_ms(1000);
		SSD1306_StartScrollRight(0,7);
		delay_ms(7000);
		SSD1306_Dim(FALSE);
		SSD1306_InvertDisplay(FALSE);
		SSD1306_StartScrollDiagLeft(0, 7);
		delay_ms(7000);
		//SSD1306_Dim(TRUE);
		SSD1306_StartScrollDiagRight(0, 7);
		delay_ms(7000);
	}
	
  printf("\n");
	printf("\n");
	printf("==> TEST SSD1306 PASSED \n");
	printf("\n");
	printf("\n");
	printf("#"); // invoke TB $finish;
	_sys_exit();
 	return 0x12;
}

